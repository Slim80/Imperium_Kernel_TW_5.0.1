## arch/arm/configs/jf_att_defconfig
```kconfig
CONFIG_MACH_JF_ATT=y
CONFIG_EXTRA_FIRMWARE="audience-es325-fw.bin"
CONFIG_EXTRA_FIRMWARE_DIR="firmware"
CONFIG_IRDA_MC96=y
# InsideSecure VPN Client
CONFIG_VPNCLIENT_SECURITY=y
CONFIG_CFG80211_REG_NOT_UPDATED=y
CONFIG_SEC_NET_FILTER=y
# Samsung ODE
CONFIG_FORCE_DISABLE_FIPS=y
```

## arch/arm/configs/jftdd_chn_cu_defconfig
```kconfig
CONFIG_MACH_JF_EUR=y
CONFIG_MACH_JFTDD_CHN_CU=y
CONFIG_EXTRA_FIRMWARE="audience-es325-fw-eur.bin"
CONFIG_EXTRA_FIRMWARE_DIR="firmware"
CONFIG_RTC_AUTO_PWRON=y
CONFIG_RTC_AUTO_PWRON_PARAM=y
CONFIG_TARGET_LOCALE_CHN=y
CONFIG_WLAN_REGION_CODE=300

# Samsung ODE
CONFIG_FORCE_DISABLE_FIPS=y
```
